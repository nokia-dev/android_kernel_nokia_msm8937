/*
 * Copyright (c) 2016, The Linux Foundation. All rights reserved.
 *
 * This program is free software; you can redistribute it and/or modify
 * it under the terms of the GNU General Public License version 2 and
 * only version 2 as published by the Free Software Foundation.
 *
 * This program is distributed in the hope that it will be useful,
 * but WITHOUT ANY WARRANTY; without even the implied warranty of
 * MERCHANTABILITY or FITNESS FOR A PARTICULAR PURPOSE.  See the
 * GNU General Public License for more details.
 */

/dts-v1/;

#include "msm8937.dtsi"
#include "msm8937-pmi8950-fih-D1-EVT.dtsi"

/ {
	model = "Qualcomm Technologies, Inc. MSM8937-PMI8950 - FIH D1 DVT";
	compatible = "qcom,msm8937-mtp", "qcom,msm8937", "qcom,mtp";
	qcom,msm-id = <294 0x2000>;
	qcom,board-id= <0x94 0>;
	qcom,pmic-id = <0x10019 0x010011 0x0 0x0>;
};
&int_codec{
    /delete-property/ qcom,cdc-us-euro-gpios;
    qcom,msm-gpios =
        "pri_i2s",
        "quat_i2s";
    qcom,pinctrl-names =
        "all_off",
        "pri_i2s_act",
        "quat_act",
        "quat_pri_i2s_act";
    pinctrl-names =
        "all_off",
        "pri_i2s_act",
        "quat_act",
        "quat_pri_i2s_act";
    pinctrl-0 = <&cdc_pdm_lines_sus
        &cdc_pdm_lines_2_sus &sec_tlmm_lines_sus>;
    pinctrl-1 = <&cdc_pdm_lines_act
        &cdc_pdm_lines_2_act &sec_tlmm_lines_sus>;
    pinctrl-2 = <&cdc_pdm_lines_sus
        &cdc_pdm_lines_2_sus &sec_tlmm_lines_act>;
    pinctrl-3 = <&cdc_pdm_lines_act
        &cdc_pdm_lines_2_act &sec_tlmm_lines_act>;
};
