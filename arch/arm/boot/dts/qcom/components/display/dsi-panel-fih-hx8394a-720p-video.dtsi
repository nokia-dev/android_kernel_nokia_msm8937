/* Copyright (c) 2013, The Linux Foundation. All rights reserved.
 *
 * This program is free software; you can redistribute it and/or modify
 * it under the terms of the GNU General Public License version 2 and
 * only version 2 as published by the Free Software Foundation.
 *
 * This program is distributed in the hope that it will be useful,
 * but WITHOUT ANY WARRANTY; without even the implied warranty of
 * MERCHANTABILITY or FITNESS FOR A PARTICULAR PURPOSE.  See the
 * GNU General Public License for more details.
 */

/*---------------------------------------------------------------------------
 * This file is autogenerated file using gcdb parser. Please do not edit it.
 * Update input XML file to add a new entry or update variable in this file
 * VERSION = "1.0"
 *---------------------------------------------------------------------------*/

/* SW4-HL-Display-UploadXdpiYdpiFromPanelDtsi-00+_20140916 */

&mdss_mdp {
	dsi_hx8394a_720_vid: fih,mdss_dsi_hx8394a_720p_video {
		fih,panel-id = <2>;
		qcom,mdss-dsi-panel-name = "hx8394a 720p video mode dsi panel";
		qcom,mdss-dsi-panel-controller = <&mdss_dsi0>;
		qcom,mdss-dsi-panel-type = "dsi_video_mode";
		qcom,mdss-dsi-panel-destination = "display_1";
		qcom,mdss-dsi-panel-framerate = <60>;
		qcom,mdss-dsi-virtual-channel-id = <0>;
		qcom,mdss-dsi-stream = <0>;
		qcom,mdss-dsi-panel-width = <720>;
		qcom,mdss-dsi-panel-height = <1280>;
		qcom,mdss-dsi-h-front-porch = <96>;
		qcom,mdss-dsi-h-back-porch = <92>;
		qcom,mdss-dsi-h-pulse-width = <40>;
		qcom,mdss-dsi-h-sync-skew = <0>;
		qcom,mdss-dsi-v-back-porch = <15>;
		qcom,mdss-dsi-v-front-porch = <8>;
		qcom,mdss-dsi-v-pulse-width = <4>;
		qcom,mdss-dsi-h-left-border = <0>;
		qcom,mdss-dsi-h-right-border = <0>;
		qcom,mdss-dsi-v-top-border = <0>;
		qcom,mdss-dsi-v-bottom-border = <0>;
		qcom,mdss-dsi-bpp = <24>;
		qcom,mdss-dsi-underflow-color = <0xff>;
		qcom,mdss-dsi-border-color = <0>;
		qcom,mdss-dsi-on-command = [39 01 00 00 00 00 04 B9 FF 83 94
				39 01 00 00 00 00 11 BA 13 82 00 16 C5 00 10 FF 0F 24 03 21 24 25 20 08
				39 01 00 00 00 00 80 C1 01 00 04 0B 16 20 28 2f 36 3F 47 4F 57 5F 67 6F 76 7E 86 8E 96 9E A6 AE B6 BE C6 CE D6 DE E6 EE F8 FF 00 00 00 00 00 00 00 00 00 00 08 10 17 21 29 30 37 40 48 51 58 60 67 70 76 7E 86 8E 96 9E A6 AE B6 BE C6 CE D6 DE E6 EE F8 FF 00 00 00 00 00 00 00 00 00 00 08 13 18 21 29 30 37 40 48 51 59 61 69 72 79 81 89 92 9A A2 AB B3 BB C3 CC D3 DB E3 EB F1 F8 FF 00 00 00 00 00 00 00 00 00
				39 01 00 00 0A 00 11 B1 01 00 37 87 01 11 11 22 2A 19 3F 57 02 00 E6 E2
				39 01 00 00 00 00 04 B2 00 C8 16
				39 01 00 00 00 00 02 C6 08
				39 01 00 00 00 00 05 BF 06 00 10 04
				39 01 00 00 00 00 17 B4 80 08 32 10 0D 32 10 08 22 10 08 37 04 4A 11 37 04 40 06 5A 5A 06
				39 01 00 00 00 00 35 D5 00 00 00 10 0A 00 01 33 00 00 33 00 23 01 67 45 01 23 88 88 88 88 88 88 88 88 88 88 88 45 99 88 54 76 10 32 32 10 88 88 88 88 88 88 88 88 88 88 88 54 88 99
				39 01 00 00 00 00 05 C7 00 10 00 10
				39 01 00 00 00 00 2B E0 00 0A 14 39 3E 3F 24 44 04 0B 0F 13 14 14 15 18 1C 00 0A 14 39 3E 3F 24 44 04 0B 0F 13 16 14 15 18 1C 08 17 0A 1A 08 17 0A 1A
				39 01 00 00 00 00 03 C0 0C 17
				39 01 00 00 00 00 02 CC 09
				39 01 00 00 00 00 02 D4 32
				39 01 00 00 00 00 02 B6 24
				39 01 00 00 00 00 02 35 01
				05 01 00 00 7D 00 02 11 00
				05 01 00 00 14 00 02 29 00];
		qcom,mdss-dsi-off-command = [05 01 00 00 7D 00 02 28 00
				05 01 00 00 00 00 02 10 00];
		qcom,mdss-dsi-ce-on-command = [
		    39 01 00 00 00 00 03 E4 03 01
		];
		qcom,mdss-dsi-ce-off-command = [
		    39 01 00 00 00 00 03 E4 00 01
		];
		qcom,mdss-dsi-ct-normal-command = [
			39 01 00 00 00 00 02 C1 00
		    39 01 00 00 00 00 2B E0 00 08 0E 33 38 3F 21 42 07 0D 10 13 15 12 14 10 17 00 08 0E 33 38 3F 21 42 07 0D 10 13 15 12 14 10 17 0B 18 08 18 0B 18 08 18
		];
		qcom,mdss-dsi-ct-warm-command = [
		    39 01 00 00 00 00 2B E0 00 0A 11 33 38 3F 25 42 06 0E 10 14 16 14 15 10 17 00 0A 11 33 38 3F 25 42 06 0E 10 14 16 14 15 10 17 0C 19 08 18 0C 19 08 18
		    39 01 00 00 00 00 80 C1 01 00 08 10 18 20 28 30 38 40 48 50 58 60 68 70 78 80 88 90 98 A0 A8 B0 B8 C0 C8 D0 D8 E0 E8 F0 F8 FF 00 00 00 00 00 00 00 00 00 00 08 10 18 20 28 30 38 40 48 50 57 5E 65 6C 73 7A 81 88 8F 96 9D A4 AB B2 B9 C0 C7 CE D5 DC E3 EA 00 00 00 00 00 00 00 00 00 00 08 10 18 20 28 30 38 40 48 50 58 60 68 70 78 80 88 90 98 A0 A9 B2 BB BE C1 C4 C7 CA CD D0 D5 D9 00 00 00 00 00 00 00 00 00
		];
		qcom,mdss-dsi-ct-cold-command = [
		    39 01 00 00 00 00 2B E0 00 0A 11 33 38 3F 24 42 07 0E 10 14 16 13 15 10 17 00 0A 11 33 38 3F 24 42 07 0E 10 14 16 13 15 10 17 0C 19 08 18 0C 19 08 18
		    39 01 00 00 00 00 80 C1 01 00 08 10 18 20 28 30 38 40 48 50 58 60 68 70 78 80 84 88 8C 90 94 98 9C A0 A4 A8 AC B0 B4 B8 BC C0 00 00 00 00 00 00 00 00 00 00 08 10 18 20 28 30 38 40 48 50 58 60 68 70 78 80 88 90 98 A0 A8 B0 B8 C0 C8 D0 D8 E0 E8 F0 F8 FF 00 00 00 00 00 00 00 00 00 00 08 10 18 20 28 30 38 40 48 50 58 60 68 70 78 80 88 90 98 A0 A8 B0 B8 C0 C8 D2 D6 DA DE E2 E6 EA 00 00 00 00 00 00 00 00 00
		];
		qcom,mdss-dsi-blf-10-command = [
		    39 01 00 00 00 00 2B E0 00 07 0D 33 38 3F 22 42 02 0B 10 14 16 14 16 10 17 00 07 0D 33 38 3F 22 42 02 0B 10 14 16 14 16 10 17 07 18 08 18 07 18 08 18
		    39 01 00 00 00 00 80 C1 01 00 08 10 18 20 28 30 38 40 48 50 58 60 68 70 78 80 88 90 98 A0 A8 B0 B8 C0 C8 D0 D8 E0 E8 F0 F8 FF 00 00 00 00 00 00 00 00 00 00 08 10 18 20 28 30 38 40 48 51 59 61 68 6F 76 7D 84 8B 92 99 A0 A7 AE B5 BC C3 CB D3 DA DF E6 EF 00 00 00 00 00 00 00 00 00 00 08 10 18 20 28 30 38 40 48 50 58 60 68 70 78 80 88 90 98 A0 B8 B0 B8 C0 C8 D0 D7 DB DF E3 E7 EA 00 00 00 00 00 00 00 00 00
		];
		qcom,mdss-dsi-blf-30-command = [
		    39 01 00 00 00 00 2B E0 00 07 0D 33 38 3F 22 42 02 0B 10 14 16 14 16 10 17 00 07 0D 33 38 3F 22 42 02 0B 10 14 16 14 16 10 17 07 18 08 18 07 18 08 18
		    39 01 00 00 00 00 80 C1 01 00 08 10 18 20 28 30 38 40 48 50 58 60 68 70 78 80 88 90 98 A0 A8 B0 B8 C0 C8 D0 D8 E0 E8 F0 F8 FF 00 00 00 00 00 00 00 00 00 00 08 10 18 20 28 30 38 40 48 50 58 5F 66 6D 74 7B 82 89 90 97 9E A5 AC B3 BA C1 C9 D1 D8 DD E4 ED 00 00 00 00 00 00 00 00 00 00 08 10 18 20 28 30 38 40 48 50 58 60 68 70 78 80 88 90 98 A0 B8 B0 B8 BE C2 C6 CA CE D2 D6 DA DD 00 00 00 00 00 00 00 00 00
		];
		qcom,mdss-dsi-blf-50-command = [
		    39 01 00 00 00 00 2B E0 00 08 0F 33 38 3F 24 42 05 0C 10 14 16 14 15 10 17 00 08 0F 33 38 3F 24 42 05 0C 10 14 16 14 15 10 17 08 19 08 18 08 19 08 18
		    39 01 00 00 00 00 80 C1 01 00 08 10 18 20 28 30 38 40 48 50 58 60 68 70 78 80 88 90 98 A0 A8 B0 B8 C0 C8 D0 D8 E0 E8 F0 F8 FF 00 00 00 00 00 00 00 00 00 00 08 10 18 20 28 30 38 40 49 53 5A 61 68 6F 76 7D 84 8B 92 99 A0 A7 AE B5 BC C3 CB D3 DA DF E6 ED 00 00 00 00 00 00 00 00 00 00 08 10 18 20 28 30 38 40 48 50 58 60 68 70 78 80 88 90 98 A0 A9 B2 BB BE C1 C4 C7 CA CD D0 D5 D9 00 00 00 00 00 00 00 00 00
		];
		qcom,mdss-dsi-blf-75-command = [
		    39 01 00 00 00 00 2B E0 00 08 0E 33 38 3F 22 42 03 0B 10 14 16 14 16 10 17 00 08 0E 33 38 3F 22 42 03 0B 10 14 16 14 16 10 17 07 18 08 18 07 18 08 18
		    39 01 00 00 00 00 80 C1 01 00 08 10 18 20 28 30 38 40 48 50 58 60 68 70 78 80 88 90 98 A0 A8 B0 B8 C0 C8 D0 D8 E0 E8 F0 F8 FF 00 00 00 00 00 00 00 00 00 00 08 10 18 20 28 30 38 40 49 53 5A 61 68 6F 76 7D 84 8B 92 99 A0 A7 AE B5 BC C3 CB D3 DA DF E6 EF 00 00 00 00 00 00 00 00 00 00 08 10 18 20 28 30 38 40 48 50 58 60 68 70 78 80 88 90 98 A0 A9 B0 B8 C0 C5 CA CE D2 D6 DA DE E1 00 00 00 00 00 00 00 00 00
		];
		qcom,mdss-dsi-on-command-state = "dsi_lp_mode";
		qcom,mdss-dsi-off-command-state = "dsi_hs_mode";
		qcom,mdss-dsi-ce-on-command-state = "dsi_hs_mode";
		qcom,mdss-dsi-ce-off-command-state = "dsi_hs_mode";
		qcom,mdss-dsi-ct-normal-command-state = "dsi_hs_mode";
		qcom,mdss-dsi-ct-warm-command-state = "dsi_hs_mode";
		qcom,mdss-dsi-ct-cold-command-state = "dsi_hs_mode";
		qcom,mdss-dsi-blf-10-command-state = "dsi_hs_mode";
		qcom,mdss-dsi-blf-30-command-state = "dsi_hs_mode";
		qcom,mdss-dsi-blf-50-command-state = "dsi_hs_mode";
		qcom,mdss-dsi-blf-75-command-state = "dsi_hs_mode";
		qcom,mdss-dsi-h-sync-pulse = <1>;
		qcom,mdss-dsi-traffic-mode = "burst_mode";
		qcom,mdss-dsi-lane-map = "lane_map_0123";
		qcom,mdss-dsi-bllp-eof-power-mode;
		qcom,mdss-dsi-bllp-power-mode;
		qcom,mdss-dsi-lane-0-state;
		qcom,mdss-dsi-lane-1-state;
		qcom,mdss-dsi-lane-2-state;
		qcom,mdss-dsi-lane-3-state;
		qcom,mdss-dsi-panel-timings = [D5 18 10 00 3A 3C 14 1A 13 03 04 00];
		qcom,mdss-dsi-t-clk-post = <0x04>;
		qcom,mdss-dsi-t-clk-pre = <0x24>;
		qcom,mdss-dsi-bl-min-level = <1>;
		qcom,mdss-dsi-bl-max-level = <255>;
		qcom,mdss-dsi-dma-trigger = "trigger_sw";
		qcom,mdss-dsi-mdp-trigger = "none";
		qcom,mdss-dsi-bl-pmic-control-type = "bl_ctrl_wled";
		qcom,mdss-dsi-reset-sequence = <1 5>, <0 1>, <1 5>;
		qcom,mdss-pan-physical-width-dimension = <62>;
		qcom,mdss-pan-physical-height-dimension = <110>;
		qcom,mdss-pan-physical-width-dimension-full = <6210>;
		qcom,mdss-pan-physical-height-dimension-full = <11040>;
	};
};

