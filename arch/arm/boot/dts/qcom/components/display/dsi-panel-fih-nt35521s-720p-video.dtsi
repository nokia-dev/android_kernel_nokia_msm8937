/* Copyright (c) 2015, The Linux Foundation. All rights reserved.
 *
 * This program is free software; you can redistribute it and/or modify
 * it under the terms of the GNU General Public License version 2 and
 * only version 2 as published by the Free Software Foundation.
 *
 * This program is distributed in the hope that it will be useful,
 * but WITHOUT ANY WARRANTY; without even the implied warranty of
 * MERCHANTABILITY or FITNESS FOR A PARTICULAR PURPOSE.  See the
 * GNU General Public License for more details.
 */

/*---------------------------------------------------------------------------
 * This file is autogenerated file using gcdb parser. Please do not edit it.
 * Update input XML file to add a new entry or update variable in this file
 * VERSION = "1.0"
 *---------------------------------------------------------------------------*/
&mdss_mdp {
	dsi_nt35521s_720_vid: fih,mdss_dsi_nt35521s_720p_video {
		fih,panel-id = <4>;
		qcom,mdss-dsi-panel-name = "nt35521s 720p video mode dsi panel";
		qcom,mdss-dsi-panel-controller = <&mdss_dsi0>;
		qcom,mdss-dsi-panel-type = "dsi_video_mode";
		qcom,mdss-dsi-panel-destination = "display_1";
		qcom,mdss-dsi-panel-framerate = <60>;
		qcom,mdss-dsi-virtual-channel-id = <0>;
		qcom,mdss-dsi-stream = <0>;
		qcom,mdss-dsi-panel-width = <720>;
		qcom,mdss-dsi-panel-height = <1280>;
		qcom,mdss-dsi-h-front-porch = <112>;
		qcom,mdss-dsi-h-back-porch = <112>;
		qcom,mdss-dsi-h-pulse-width = <8>;
		qcom,mdss-dsi-h-sync-skew = <0>;
		qcom,mdss-dsi-v-front-porch = <20>;
		qcom,mdss-dsi-v-back-porch = <12>;
		qcom,mdss-dsi-v-pulse-width = <2>;
		qcom,mdss-dsi-h-left-border = <0>;
		qcom,mdss-dsi-h-right-border = <0>;
		qcom,mdss-dsi-v-top-border = <0>;
		qcom,mdss-dsi-v-bottom-border = <0>;
		qcom,mdss-dsi-bpp = <24>;
		qcom,mdss-dsi-underflow-color = <0xff>;
		qcom,mdss-dsi-border-color = <0>;
	        qcom,mdss-dsi-on-command = [
	        	39 01 00 00 00 00 05 FF AA 55 25 01
	        	15 01 00 00 00 00 02 6F 16
	        	15 01 00 00 00 00 02 F7 10
	        	39 01 00 00 0A 00 05 FF AA 55 25 01
	                05 01 00 00 69 00 02 11 00
	                05 01 00 00 0F 00 02 29 00
	                15 01 00 00 00 00 02 51 FF
			15 01 00 00 00 00 02 53 24
		];
		qcom,mdss-dsi-off-command = [
			05 01 00 00 78 00 02 28 00
			05 01 00 00 00 00 02 10 00
		];

		qcom,mdss-dsi-ce-on-command = [
			39 00 00 00 00 00 02 55 80
			39 00 00 00 00 00 06 F0 55 AA 52 08 00
			39 01 00 00 00 00 07 CC 41 36 87 A0 8C CA
		];
		qcom,mdss-dsi-ce-off-command = [
			39 01 00 00 00 00 02 55 00
		];

		qcom,mdss-dsi-ct-normal-command = [
			39 00 00 00 00 00 06 F0 55 AA 52 08 02
			15 01 00 00 05 00 02 EE 03
			39 00 00 00 00 00 11 B0 00 28 00 3C 00 63 00 8A 00 B2 00 D3 00 F5 01 22
			39 00 00 00 00 00 11 B1 01 46 01 80 01 AC 01 F1 02 28 02 2A 02 5C 02 93
			39 00 00 00 00 00 11 B2 02 B5 02 E3 03 03 03 2B 03 47 03 6B 03 88 03 A5
			39 01 00 00 00 00 05 B3 03 C2 03 D1
			39 00 00 00 00 00 11 B4 00 6D 00 7B 00 97 00 B3 00 CF 00 EB 01 08 01 30
			39 00 00 00 00 00 11 B5 01 52 01 88 01 B3 01 F6 02 2C 02 2E 02 60 02 96
			39 00 00 00 00 00 11 B6 02 B9 02 E9 03 0B 03 37 03 57 03 7B 03 94 03 AC
			39 01 00 00 00 00 05 B7 03 C4 03 D1
			39 00 00 00 00 00 11 B8 00 FE 01 03 01 0D 01 17 01 21 01 31 01 42 01 60
			39 00 00 00 00 00 11 B9 01 79 01 A4 01 C7 02 04 02 36 02 38 02 67 02 9C
			39 00 00 00 00 00 11 BA 02 BC 02 E9 03 09 03 36 03 5D 03 86 03 9B 03 B0
			39 01 00 00 00 00 05 BB 03 C6 03 D1
		];
		qcom,mdss-dsi-ct-warm-command = [
			39 00 00 00 00 00 06 F0 55 AA 52 08 02
			15 01 00 00 05 00 02 EE 03
			39 00 00 00 00 00 11 B0 00 00 00 44 00 76 00 95 00 AB 00 CF 00 ED 01 1B
			39 00 00 00 00 00 11 B1 01 3F 01 78 01 A4 01 E9 02 21 02 22 02 54 02 8A
			39 00 00 00 00 00 11 B2 02 AC 02 DA 02 F9 03 24 03 3F 03 60 03 75 03 8E
			39 01 00 00 00 00 05 B3 03 E2 03 FF
			39 00 00 00 00 00 11 B4 00 E3 00 EA 00 F6 01 02 01 0D 01 20 01 32 01 50
			39 00 00 00 00 00 11 B5 01 6C 01 98 01 BD 01 FA 02 2D 02 2F 02 5F 02 94
			39 00 00 00 00 00 11 B6 02 B7 02 E7 03 08 03 34 03 50 03 77 03 8F 03 B0
			39 01 00 00 00 00 05 B7 03 F1 03 FF
			39 00 00 00 00 00 11 B8 01 50 01 53 01 59 01 60 01 66 01 71 01 7B 01 8F
			39 00 00 00 00 00 11 B9 01 A2 01 C2 01 DF 02 12 02 3F 02 40 02 6D 02 A2
			39 00 00 00 00 00 11 BA 02 C6 02 FC 03 25 03 4C 03 59 03 7D 03 8C 03 B1
			39 01 00 00 00 00 05 BB 03 E0 03 FF
		];
		qcom,mdss-dsi-ct-cold-command = [
			39 00 00 00 00 00 06 F0 55 AA 52 08 02
			15 01 00 00 05 00 02 EE 03
			39 00 00 00 00 00 11 B0 00 B9 00 C3 00 D3 00 E2 00 F0 01 08 01 1D 01 3F
			39 00 00 00 00 00 11 B1 01 5D 01 8E 01 B6 01 F4 02 28 02 2A 02 5A 02 8F
			39 00 00 00 00 00 11 B2 02 B1 02 DF 02 FF 03 29 03 45 03 60 03 73 03 8A
			39 01 00 00 00 00 05 B3 03 E9 03 FF
			39 00 00 00 00 00 11 B4 00 00 00 42 00 70 00 91 00 A8 00 CD 00 EB 01 1A
			39 00 00 00 00 00 11 B5 01 3E 01 78 01 A5 01 E9 02 21 02 23 02 56 02 8C
			39 00 00 00 00 00 11 B6 02 AF 02 DF 03 01 03 2D 03 4B 03 72 03 8B 03 AD
			39 01 00 00 00 00 05 B7 03 E6 03 FF
			39 00 00 00 00 00 11 B8 00 9D 00 A7 00 B9 00 C9 00 D9 00 F4 01 0B 01 31
			39 00 00 00 00 00 11 B9 01 50 01 85 01 AE 01 F0 02 26 02 28 02 5A 02 91
			39 00 00 00 00 00 11 BA 02 B5 02 E9 03 10 03 4E 03 73 03 94 03 98 03 B4
			39 01 00 00 00 00 05 BB 03 EB 03 FF
		];
		qcom,mdss-dsi-blf-10-command = [
			39 00 00 00 00 00 06 F0 55 AA 52 08 02
			15 01 00 00 05 00 02 EE 03
			39 00 00 00 00 00 11 B0 00 00 00 46 00 77 00 95 00 AB 00 CF 00 ED 01 1C
			39 00 00 00 00 00 11 B1 01 3F 01 78 01 A5 01 E9 02 20 02 22 02 54 02 8A
			39 00 00 00 00 00 11 B2 02 AD 02 DA 02 FA 03 24 03 3F 03 62 03 7C 03 8A
			39 01 00 00 00 00 05 B3 03 E9 03 FF
			39 00 00 00 00 00 11 B4 00 40 00 59 00 81 00 9D 00 B3 00 D5 00 F2 01 1F
			39 00 00 00 00 00 11 B5 01 42 01 7A 01 A6 01 EB 02 23 02 25 02 57 02 8D
			39 00 00 00 00 00 11 B6 02 B1 02 E1 03 02 03 2E 03 4C 03 72 03 8D 03 AE
			39 01 00 00 00 00 05 B7 03 E6 03 FF
			39 00 00 00 00 00 11 B8 01 38 01 3B 01 43 01 4A 01 51 01 5E 01 6A 01 80
			39 00 00 00 00 00 11 B9 01 94 01 B7 01 D6 02 0B 02 3A 02 3B 02 69 02 9E
			39 00 00 00 00 00 11 BA 02 C3 02 F8 03 21 03 70 03 9F 03 C8 03 CE 03 D1
			39 01 00 00 00 00 05 BB 03 EB 03 FF
		];
		qcom,mdss-dsi-blf-30-command = [
			39 00 00 00 00 00 06 F0 55 AA 52 08 02
			15 01 00 00 05 00 02 EE 03
			39 00 00 00 00 00 11 B0 00 00 00 46 00 77 00 95 00 AB 00 CF 00 ED 01 1C
			39 00 00 00 00 00 11 B1 01 3F 01 78 01 A5 01 E9 02 20 02 22 02 54 02 8A
			39 00 00 00 00 00 11 B2 02 AC 02 DB 02 FA 03 24 03 40 03 62 03 75 03 8A
			39 01 00 00 00 00 05 B3 03 E9 03 FF
			39 00 00 00 00 00 11 B4 00 47 00 64 00 85 00 9E 00 B4 00 D6 00 F4 01 21
			39 00 00 00 00 00 11 B5 01 43 01 7B 01 A8 01 EB 02 23 02 25 02 57 02 8E
			39 00 00 00 00 00 11 B6 02 B1 02 E1 03 02 03 2E 03 4C 03 72 03 8D 03 AF
			39 01 00 00 00 00 05 B7 03 E6 03 FF
			39 00 00 00 00 00 11 B8 01 73 01 76 01 7A 01 7F 01 84 01 8D 01 97 01 A8
			39 00 00 00 00 00 11 B9 01 B7 01 D4 01 EE 02 1C 02 47 02 48 02 73 02 A8
			39 00 00 00 00 00 11 BA 02 CC 03 04 03 2E 03 53 03 5E 03 79 03 8C 03 B5
			39 01 00 00 00 00 05 BB 03 EB 03 FF
		];
		qcom,mdss-dsi-blf-50-command = [
			39 00 00 00 00 00 06 F0 55 AA 52 08 02
			15 01 00 00 05 00 02 EE 03
			39 00 00 00 00 00 11 B0 00 00 00 44 00 77 00 95 00 AB 00 CF 00 EC 01 1B
			39 00 00 00 00 00 11 B1 01 3E 01 78 01 A5 01 E9 02 20 02 22 02 53 02 8A
			39 00 00 00 00 00 11 B2 02 AB 02 DB 02 FA 03 24 03 43 03 62 03 75 03 8E
			39 01 00 00 00 00 05 B3 03 E2 03 FF
			39 00 00 00 00 00 11 B4 00 C7 00 CF 00 DE 00 EC 00 F9 01 0F 01 23 01 45
			39 00 00 00 00 00 11 B5 01 61 01 91 01 B8 01 F6 02 2A 02 2C 02 5C 02 92
			39 00 00 00 00 00 11 B6 02 B5 02 E6 03 07 03 33 03 54 03 75 03 8F 03 AE
			39 01 00 00 00 00 05 B7 03 F1 03 FF
			39 00 00 00 00 00 11 B8 01 C5 01 C6 01 C9 01 CC 01 CF 01 D5 01 DA 01 E6
			39 00 00 00 00 00 11 B9 01 F0 02 04 02 18 02 3C 02 60 02 62 02 88 02 BC
			39 00 00 00 00 00 11 BA 02 E2 03 1E 03 54 03 77 03 7B 03 81 03 8E 03 B1
			39 01 00 00 00 00 05 BB 03 E0 03 FF
		];
		qcom,mdss-dsi-blf-75-command = [
			39 00 00 00 00 00 06 F0 55 AA 52 08 02
			15 01 00 00 05 00 02 EE 03
			39 00 00 00 00 00 11 B0 00 00 00 46 00 77 00 94 00 A9 00 CF 00 ED 01 1C
			39 00 00 00 00 00 11 B1 01 3F 01 78 01 A4 01 E9 02 1F 02 21 02 54 02 89
			39 00 00 00 00 00 11 B2 02 AC 02 D9 02 FD 03 2C 03 4E 03 66 03 74 03 8E
			39 01 00 00 00 00 05 B3 03 E9 03 FF
			39 00 00 00 00 00 11 B4 01 2B 01 2F 01 37 01 3F 01 46 01 54 01 61 01 79
			39 00 00 00 00 00 11 B5 01 8D 01 B2 01 D2 02 08 02 37 02 38 02 66 02 9A
			39 00 00 00 00 00 11 B6 02 BD 02 ED 03 12 03 41 03 63 03 7C 03 94 03 B6
			39 01 00 00 00 00 05 B7 03 EC 03 FF
			39 00 00 00 00 00 11 B8 02 1A 02 1B 02 1D 02 1E 02 20 02 24 02 27 02 2E
			39 00 00 00 00 00 11 B9 02 35 02 42 02 4F 02 6B 02 88 02 89 02 AE 02 E4
			39 00 00 00 00 00 11 BA 03 0E 03 60 03 68 03 71 03 75 03 79 03 8E 03 B6
			39 01 00 00 00 00 05 BB 03 F2 03 FF
		];

		qcom,mdss-dsi-cabc-off-command = [
			39 01 00 00 00 00 02 55 00
		];

		qcom,mdss-dsi-cabc-ui-command = [
			39 01 00 00 00 00 02 55 01
		];

		qcom,mdss-dsi-cabc-still-command = [
			39 01 00 00 00 00 02 55 02
		];

		qcom,mdss-dsi-cabc-moving-command = [
			39 01 00 00 00 00 02 55 03
		];

		qcom,mdss-dsi-on-command-state = "dsi_lp_mode";
		qcom,mdss-dsi-off-command-state = "dsi_lp_mode";

		qcom,mdss-dsi-ce-on-command-state = "dsi_lp_mode";
		qcom,mdss-dsi-ce-off-command-state = "dsi_lp_mode";

		qcom,mdss-dsi-ct-normal-command-state = "dsi_lp_mode";
		qcom,mdss-dsi-ct-warm-command-state = "dsi_lp_mode";
		qcom,mdss-dsi-ct-cold-command-state = "dsi_lp_mode";
		qcom,mdss-dsi-blf-10-command-state = "dsi_lp_mode";
		qcom,mdss-dsi-blf-30-command-state = "dsi_lp_mode";
		qcom,mdss-dsi-blf-50-command-state = "dsi_lp_mode";
		qcom,mdss-dsi-blf-75-command-state = "dsi_lp_mode";

		qcom,mdss-dsi-cabc-off-command-state = "dsi_lp_mode";
		qcom,mdss-dsi-cabc-ui-command-state = "dsi_lp_mode";
		qcom,mdss-dsi-cabc-still-command-state = "dsi_lp_mode";
		qcom,mdss-dsi-cabc-moving-command-state = "dsi_lp_mode";

		/* Display-SendCECTCABCBeforeInit-00*{_20161213 */
		qcom,mdss-dsi-ce-on-command-BeforeInit = [
			39 01 00 00 00 00 02 55 80
			39 01 00 00 00 00 06 F0 55 AA 52 08 00
			39 01 00 00 00 00 07 CC 41 36 87 A0 8C CA
		];

		qcom,mdss-dsi-ce-off-command-BeforeInit  = [
			39 01 00 00 00 00 02 55 00
		];

		qcom,mdss-dsi-ct-normal-command-BeforeInit = [
			39 01 00 00 00 00 06 F0 55 AA 52 08 02
			15 01 00 00 05 00 02 EE 03
			39 01 00 00 00 00 11 B0 00 28 00 3C 00 63 00 8A 00 B2 00 D3 00 F5 01 22
			39 01 00 00 00 00 11 B1 01 46 01 80 01 AC 01 F1 02 28 02 2A 02 5C 02 93
			39 01 00 00 00 00 11 B2 02 B5 02 E3 03 03 03 2B 03 47 03 6B 03 88 03 A5
			39 01 00 00 00 00 05 B3 03 C2 03 D1
			39 01 00 00 00 00 11 B4 00 6D 00 7B 00 97 00 B3 00 CF 00 EB 01 08 01 30
			39 01 00 00 00 00 11 B5 01 52 01 88 01 B3 01 F6 02 2C 02 2E 02 60 02 96
			39 01 00 00 00 00 11 B6 02 B9 02 E9 03 0B 03 37 03 57 03 7B 03 94 03 AC
			39 01 00 00 00 00 05 B7 03 C4 03 D1
			39 01 00 00 00 00 11 B8 00 FE 01 03 01 0D 01 17 01 21 01 31 01 42 01 60
			39 01 00 00 00 00 11 B9 01 79 01 A4 01 C7 02 04 02 36 02 38 02 67 02 9C
			39 01 00 00 00 00 11 BA 02 BC 02 E9 03 09 03 36 03 5D 03 86 03 9B 03 B0
			39 01 00 00 00 00 05 BB 03 C6 03 D1
		];
		qcom,mdss-dsi-ct-warm-command-BeforeInit = [
			39 01 00 00 00 00 06 F0 55 AA 52 08 02
			15 01 00 00 05 00 02 EE 03
			39 01 00 00 00 00 11 B0 00 00 00 44 00 76 00 95 00 AB 00 CF 00 ED 01 1B
			39 01 00 00 00 00 11 B1 01 3F 01 78 01 A4 01 E9 02 21 02 22 02 54 02 8A
			39 01 00 00 00 00 11 B2 02 AC 02 DA 02 F9 03 24 03 3F 03 60 03 75 03 8E
			39 01 00 00 00 00 05 B3 03 E2 03 FF
			39 01 00 00 00 00 11 B4 00 E3 00 EA 00 F6 01 02 01 0D 01 20 01 32 01 50
			39 01 00 00 00 00 11 B5 01 6C 01 98 01 BD 01 FA 02 2D 02 2F 02 5F 02 94
			39 01 00 00 00 00 11 B6 02 B7 02 E7 03 08 03 34 03 50 03 77 03 8F 03 B0
			39 01 00 00 00 00 05 B7 03 F1 03 FF
			39 01 00 00 00 00 11 B8 01 50 01 53 01 59 01 60 01 66 01 71 01 7B 01 8F
			39 01 00 00 00 00 11 B9 01 A2 01 C2 01 DF 02 12 02 3F 02 40 02 6D 02 A2
			39 01 00 00 00 00 11 BA 02 C6 02 FC 03 25 03 4C 03 59 03 7D 03 8C 03 B1
			39 01 00 00 00 00 05 BB 03 E0 03 FF
		];
		qcom,mdss-dsi-ct-cold-command-BeforeInit = [
			39 01 00 00 00 00 06 F0 55 AA 52 08 02
			15 01 00 00 05 00 02 EE 03
			39 01 00 00 00 00 11 B0 00 B9 00 C3 00 D3 00 E2 00 F0 01 08 01 1D 01 3F
			39 01 00 00 00 00 11 B1 01 5D 01 8E 01 B6 01 F4 02 28 02 2A 02 5A 02 8F
			39 01 00 00 00 00 11 B2 02 B1 02 DF 02 FF 03 29 03 45 03 60 03 73 03 8A
			39 01 00 00 00 00 05 B3 03 E9 03 FF
			39 01 00 00 00 00 11 B4 00 00 00 42 00 70 00 91 00 A8 00 CD 00 EB 01 1A
			39 01 00 00 00 00 11 B5 01 3E 01 78 01 A5 01 E9 02 21 02 23 02 56 02 8C
			39 01 00 00 00 00 11 B6 02 AF 02 DF 03 01 03 2D 03 4B 03 72 03 8B 03 AD
			39 01 00 00 00 00 05 B7 03 E6 03 FF
			39 01 00 00 00 00 11 B8 00 9D 00 A7 00 B9 00 C9 00 D9 00 F4 01 0B 01 31
			39 01 00 00 00 00 11 B9 01 50 01 85 01 AE 01 F0 02 26 02 28 02 5A 02 91
			39 01 00 00 00 00 11 BA 02 B5 02 E9 03 10 03 4E 03 73 03 94 03 98 03 B4
			39 01 00 00 00 00 05 BB 03 EB 03 FF
		];
		qcom,mdss-dsi-blf-10-command-BeforeInit = [
			39 01 00 00 00 00 06 F0 55 AA 52 08 02
			15 01 00 00 05 00 02 EE 03
			39 01 00 00 00 00 11 B0 00 00 00 46 00 77 00 95 00 AB 00 CF 00 ED 01 1C
			39 01 00 00 00 00 11 B1 01 3F 01 78 01 A5 01 E9 02 20 02 22 02 54 02 8A
			39 01 00 00 00 00 11 B2 02 AD 02 DA 02 FA 03 24 03 3F 03 62 03 7C 03 8A
			39 01 00 00 00 00 05 B3 03 E9 03 FF
			39 01 00 00 00 00 11 B4 00 40 00 59 00 81 00 9D 00 B3 00 D5 00 F2 01 1F
			39 01 00 00 00 00 11 B5 01 42 01 7A 01 A6 01 EB 02 23 02 25 02 57 02 8D
			39 01 00 00 00 00 11 B6 02 B1 02 E1 03 02 03 2E 03 4C 03 72 03 8D 03 AE
			39 01 00 00 00 00 05 B7 03 E6 03 FF
			39 01 00 00 00 00 11 B8 01 38 01 3B 01 43 01 4A 01 51 01 5E 01 6A 01 80
			39 01 00 00 00 00 11 B9 01 94 01 B7 01 D6 02 0B 02 3A 02 3B 02 69 02 9E
			39 01 00 00 00 00 11 BA 02 C3 02 F8 03 21 03 70 03 9F 03 C8 03 CE 03 D1
			39 01 00 00 00 00 05 BB 03 EB 03 FF
		];
		qcom,mdss-dsi-blf-30-command-BeforeInit = [
			39 01 00 00 00 00 06 F0 55 AA 52 08 02
			15 01 00 00 05 00 02 EE 03
			39 01 00 00 00 00 11 B0 00 00 00 46 00 77 00 95 00 AB 00 CF 00 ED 01 1C
			39 01 00 00 00 00 11 B1 01 3F 01 78 01 A5 01 E9 02 20 02 22 02 54 02 8A
			39 01 00 00 00 00 11 B2 02 AC 02 DB 02 FA 03 24 03 40 03 62 03 75 03 8A
			39 01 00 00 00 00 05 B3 03 E9 03 FF
			39 01 00 00 00 00 11 B4 00 47 00 64 00 85 00 9E 00 B4 00 D6 00 F4 01 21
			39 01 00 00 00 00 11 B5 01 43 01 7B 01 A8 01 EB 02 23 02 25 02 57 02 8E
			39 01 00 00 00 00 11 B6 02 B1 02 E1 03 02 03 2E 03 4C 03 72 03 8D 03 AF
			39 01 00 00 00 00 05 B7 03 E6 03 FF
			39 01 00 00 00 00 11 B8 01 73 01 76 01 7A 01 7F 01 84 01 8D 01 97 01 A8
			39 01 00 00 00 00 11 B9 01 B7 01 D4 01 EE 02 1C 02 47 02 48 02 73 02 A8
			39 01 00 00 00 00 11 BA 02 CC 03 04 03 2E 03 53 03 5E 03 79 03 8C 03 B5
			39 01 00 00 00 00 05 BB 03 EB 03 FF
		];
		qcom,mdss-dsi-blf-50-command-BeforeInit = [
			39 01 00 00 00 00 06 F0 55 AA 52 08 02
			15 01 00 00 05 00 02 EE 03
			39 01 00 00 00 00 11 B0 00 00 00 44 00 77 00 95 00 AB 00 CF 00 EC 01 1B
			39 01 00 00 00 00 11 B1 01 3E 01 78 01 A5 01 E9 02 20 02 22 02 53 02 8A
			39 01 00 00 00 00 11 B2 02 AB 02 DB 02 FA 03 24 03 43 03 62 03 75 03 8E
			39 01 00 00 00 00 05 B3 03 E2 03 FF
			39 01 00 00 00 00 11 B4 00 C7 00 CF 00 DE 00 EC 00 F9 01 0F 01 23 01 45
			39 01 00 00 00 00 11 B5 01 61 01 91 01 B8 01 F6 02 2A 02 2C 02 5C 02 92
			39 01 00 00 00 00 11 B6 02 B5 02 E6 03 07 03 33 03 54 03 75 03 8F 03 AE
			39 01 00 00 00 00 05 B7 03 F1 03 FF
			39 01 00 00 00 00 11 B8 01 C5 01 C6 01 C9 01 CC 01 CF 01 D5 01 DA 01 E6
			39 01 00 00 00 00 11 B9 01 F0 02 04 02 18 02 3C 02 60 02 62 02 88 02 BC
			39 01 00 00 00 00 11 BA 02 E2 03 1E 03 54 03 77 03 7B 03 81 03 8E 03 B1
			39 01 00 00 00 00 05 BB 03 E0 03 FF
		];
		qcom,mdss-dsi-blf-75-command-BeforeInit = [
			39 01 00 00 00 00 06 F0 55 AA 52 08 02
			15 01 00 00 05 00 02 EE 03
			39 01 00 00 00 00 11 B0 00 00 00 46 00 77 00 94 00 A9 00 CF 00 ED 01 1C
			39 01 00 00 00 00 11 B1 01 3F 01 78 01 A4 01 E9 02 1F 02 21 02 54 02 89
			39 01 00 00 00 00 11 B2 02 AC 02 D9 02 FD 03 2C 03 4E 03 66 03 74 03 8E
			39 01 00 00 00 00 05 B3 03 E9 03 FF
			39 01 00 00 00 00 11 B4 01 2B 01 2F 01 37 01 3F 01 46 01 54 01 61 01 79
			39 01 00 00 00 00 11 B5 01 8D 01 B2 01 D2 02 08 02 37 02 38 02 66 02 9A
			39 01 00 00 00 00 11 B6 02 BD 02 ED 03 12 03 41 03 63 03 7C 03 94 03 B6
			39 01 00 00 00 00 05 B7 03 EC 03 FF
			39 01 00 00 00 00 11 B8 02 1A 02 1B 02 1D 02 1E 02 20 02 24 02 27 02 2E
			39 01 00 00 00 00 11 B9 02 35 02 42 02 4F 02 6B 02 88 02 89 02 AE 02 E4
			39 01 00 00 00 00 11 BA 03 0E 03 60 03 68 03 71 03 75 03 79 03 8E 03 B6
			39 01 00 00 00 00 05 BB 03 F2 03 FF
		];

		qcom,mdss-dsi-cabc-off-command-BeforeInit = [
			39 01 00 00 00 00 02 55 00
		];

		qcom,mdss-dsi-cabc-ui-command-BeforeInit = [
			39 01 00 00 00 00 02 55 01
		];

		qcom,mdss-dsi-cabc-still-command-BeforeInit = [
			39 01 00 00 00 00 02 55 02
		];

		qcom,mdss-dsi-cabc-moving-command-BeforeInit = [
			39 01 00 00 00 00 02 55 03
		];

		qcom,mdss-dsi-ce-on-command-BeforeInit-state = "dsi_lp_mode";
		qcom,mdss-dsi-ce-off-command-BeforeInit-state = "dsi_lp_mode";

		qcom,mdss-dsi-ct-normal-command-BeforeInit-state = "dsi_lp_mode";
		qcom,mdss-dsi-ct-warm-command-BeforeInit-state = "dsi_lp_mode";
		qcom,mdss-dsi-ct-cold-command-BeforeInit-state = "dsi_lp_mode";
		qcom,mdss-dsi-blf-10-command-BeforeInit-state = "dsi_lp_mode";
		qcom,mdss-dsi-blf-30-command-BeforeInit-state = "dsi_lp_mode";
		qcom,mdss-dsi-blf-50-command-BeforeInit-state = "dsi_lp_mode";
		qcom,mdss-dsi-blf-75-command-BeforeInit-state = "dsi_lp_mode";

		qcom,mdss-dsi-cabc-off-command-BeforeInit-state = "dsi_lp_mode";
		qcom,mdss-dsi-cabc-ui-command-BeforeInit-state = "dsi_lp_mode";
		qcom,mdss-dsi-cabc-still-command-BeforeInit-state = "dsi_lp_mode";
		qcom,mdss-dsi-cabc-moving-command-BeforeInit-state = "dsi_lp_mode";
		/* Display-SendCECTCABCBeforeInit-00+}_20161213 */

		qcom,mdss-dsi-h-sync-pulse = <1>;
		qcom,mdss-dsi-traffic-mode = "burst_mode";
		qcom,mdss-dsi-bllp-eof-power-mode;
		qcom,mdss-dsi-bllp-power-mode;
		qcom,mdss-dsi-lane-0-state;
		qcom,mdss-dsi-lane-1-state;
		qcom,mdss-dsi-lane-2-state;
		qcom,mdss-dsi-panel-timings = [a9 24 18 00 4e 52 1c 28 1f 03 04 00];
		qcom,mdss-dsi-t-clk-post = <0x04>;
		qcom,mdss-dsi-t-clk-pre = <0x21>;
		qcom,mdss-dsi-bl-min-level = <1>;
		qcom,mdss-dsi-bl-max-level = <4095>;
		qcom,mdss-dsi-dma-trigger = "trigger_sw";
		qcom,mdss-dsi-mdp-trigger = "none";
		qcom,mdss-dsi-bl-pmic-control-type = "bl_ctrl_wled";
		qcom,mdss-dsi-reset-sequence = <1 2>, <0 1>, <1 25>;
		qcom,mdss-pan-physical-width-dimension = <64>;
		qcom,mdss-pan-physical-height-dimension = <115>;
		qcom,mdss-pan-physical-width-dimension-full = <6480>;
		qcom,mdss-pan-physical-height-dimension-full = <11520>;
		qcom,mdss-dsi-lp11-init;
		qcom,mdss-dsi-init-delay-us = <100>;
	};
};

