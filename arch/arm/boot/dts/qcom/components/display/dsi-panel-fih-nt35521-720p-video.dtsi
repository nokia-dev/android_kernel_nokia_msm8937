/* Copyright (c) 2015, The Linux Foundation. All rights reserved.
 *
 * This program is free software; you can redistribute it and/or modify
 * it under the terms of the GNU General Public License version 2 and
 * only version 2 as published by the Free Software Foundation.
 *
 * This program is distributed in the hope that it will be useful,
 * but WITHOUT ANY WARRANTY; without even the implied warranty of
 * MERCHANTABILITY or FITNESS FOR A PARTICULAR PURPOSE.  See the
 * GNU General Public License for more details.
 */

/*---------------------------------------------------------------------------
 * This file is autogenerated file using gcdb parser. Please do not edit it.
 * Update input XML file to add a new entry or update variable in this file
 * VERSION = "1.0"
 *---------------------------------------------------------------------------*/

&mdss_mdp {
	dsi_nt35521_720_vid: fih,mdss_dsi_nt35521_720p_video {
		fih,panel-id = <3>;
		qcom,mdss-dsi-panel-name = "nt35521 720p video mode dsi panel";
		qcom,mdss-dsi-panel-controller = <&mdss_dsi0>;
		qcom,mdss-dsi-panel-type = "dsi_video_mode";
		qcom,mdss-dsi-panel-destination = "display_1";
		qcom,mdss-dsi-panel-framerate = <60>;
		qcom,mdss-dsi-virtual-channel-id = <0>;
		qcom,mdss-dsi-stream = <0>;
		qcom,mdss-dsi-panel-width = <720>;
		qcom,mdss-dsi-panel-height = <1280>;
		qcom,mdss-dsi-h-front-porch = <52>;
		qcom,mdss-dsi-h-back-porch = <52>;
		qcom,mdss-dsi-h-pulse-width = <4>;
		qcom,mdss-dsi-h-sync-skew = <0>;
		qcom,mdss-dsi-v-back-porch = <50>;
		qcom,mdss-dsi-v-front-porch = <50>;
		qcom,mdss-dsi-v-pulse-width = <1>;
		qcom,mdss-dsi-h-left-border = <0>;
		qcom,mdss-dsi-h-right-border = <0>;
		qcom,mdss-dsi-v-top-border = <0>;
		qcom,mdss-dsi-v-bottom-border = <0>;
		qcom,mdss-dsi-bpp = <24>;
		qcom,mdss-dsi-underflow-color = <0xff>;
		qcom,mdss-dsi-border-color = <0>;
	        qcom,mdss-dsi-on-command = [
	                05 01 00 00 78 00 02 11 00
	                05 01 00 00 78 00 02 29 00
		];
		qcom,mdss-dsi-off-command = [
			05 01 00 00 78 00 02 28 00
			05 01 00 00 00 00 02 10 00
		];
		qcom,mdss-dsi-ce-on-command = [
			39 00 00 00 00 00 06 F0 55 AA 52 08 00
			39 00 00 00 00 00 11 CC 41 36 87 00 00 00 00 00 00 00 00 00 40 08 A5 05
		    39 01 00 00 00 00 02 55 80
		];
		qcom,mdss-dsi-ce-off-command = [
		    39 01 00 00 00 00 02 55 00
		];
		qcom,mdss-dsi-ct-normal-command = [
			39 00 00 00 00 00 06 F0 55 AA 52 08 02
			39 00 00 00 00 00 02 EE 03
			39 01 00 00 00 00 11 B0 00 FD 01 02 01 0A 01 16 01 21 01 2E 01 3D 01 5A
			39 00 00 00 00 00 11 B1 01 74 01 9D 01 BF 01 FB 02 2D 02 32 02 60 02 9A
			39 00 00 00 00 00 11 B2 02 C3 02 F7 03 1B 03 4A 03 6E 03 7C 03 A1 03 F0
			39 01 00 00 00 00 05 B3 03 FC 03 FD
			39 00 00 00 00 00 11 B4 00 F6 00 FB 01 06 01 0F 01 18 01 2A 01 3A 01 56
			39 00 00 00 00 00 11 B5 01 6E 01 99 01 BE 01 F9 02 2D 02 2E 02 61 02 9B
			39 01 00 00 00 00 11 B6 02 C3 02 F9 03 1E 03 53 03 7B 03 8B 03 AC 03 F6
			39 00 00 00 00 00 05 B7 03 FE 03 FE
			39 00 00 00 00 00 11 B8 00 CB 00 D3 00 E0 00 EC 00 F7 01 0B 01 1E 01 3F
			39 01 00 00 00 00 11 B9 01 5A 01 89 01 B2 01 F1 02 26 02 28 02 5B 02 97
			39 00 00 00 00 00 11 BA 02 BF 02 F7 03 1E 03 5D 03 B6 03 DC 03 E6 03 EB
			39 01 00 00 00 00 05 BB 03 F9 03 FA
		];
		qcom,mdss-dsi-ct-warm-command = [
			39 00 00 00 00 00 06 F0 55 AA 52 08 02
			39 00 00 00 00 00 02 EE 03
		       39 01 00 00 00 00 11 B0 00 C6 00 D0 00 E1 00 EB 00 F8 01 09 01 1E 01 3E
			39 00 00 00 00 00 11 B1 01 5B 01 8A 01 B4 01 F3 02 29 02 2C 02 5D 02 98
			39 00 00 00 00 00 11 B2 02 BE 02 F4 03 16 03 46 03 55 03 92 03 B1 03 F0
			39 01 00 00 00 00 05 B3 03 FC 03 FD
			39 00 00 00 00 00 11 B4 01 1B 01 1F 01 27 01 2F 01 37 01 46 01 53 01 6B
			39 00 00 00 00 00 11 B5 01 81 01 A8 01 C9 02 01 02 33 02 34 02 65 02 9F
			39 01 00 00 00 00 11 B6 02 C7 02 FC 03 23 03 57 03 68 03 9E 03 B9 03 F6
			39 00 00 00 00 00 05 B7 03 FE 03 FE
			39 00 00 00 00 00 11 B8 01 45 01 48 01 4E 01 55 01 5A 01 66 01 71 01 85
			39 01 00 00 00 00 11 B9 01 98 01 BA 01 D8 02 0B 02 3A 02 3C 02 6B 02 A5
			39 00 00 00 00 00 11 BA 02 CD 03 07 03 32 03 85 03 FA 03 FB 03 FC 03 FD
			39 01 00 00 00 00 05 BB 03 FE 03 FE
		];
		qcom,mdss-dsi-ct-cold-command = [
			39 00 00 00 00 00 06 F0 55 AA 52 08 02
			39 00 00 00 00 00 02 EE 03
		  	39 01 00 00 00 00 11 B0 00 C1 00 DE 00 FB 00 FC 01 03 01 1A 01 2C 01 4B
			39 00 00 00 00 00 11 B1 01 67 01 90 01 B8 01 F5 02 2A 02 2E 02 5E 02 97
			39 00 00 00 00 00 11 B2 02 BF 02 F4 03 19 03 47 03 68 03 9D 03 9F 03 F0
			39 01 00 00 00 00 05 B3 03 FC 03 FD
			39 00 00 00 00 00 11 B4 00 EC 00 ED 00 F6 01 04 01 0E 01 20 01 31 01 4E
			39 00 00 00 00 00 11 B5 01 68 01 95 01 BA 01 F7 02 2B 02 2C 02 5F 02 9A
			39 01 00 00 00 00 11 B6 02 C2 02 F8 03 1D 03 53 03 7C 03 F0 03 F6 03 FE
			39 00 00 00 00 00 05 B7 03 FE 03 FE
			39 00 00 00 00 00 11 B8 00 01 00 02 00 03 00 10 00 50 00 8C 00 B6 00 F1
			39 01 00 00 00 00 11 B9 01 1B 01 5B 01 8D 01 DB 02 17 02 18 02 50 02 8C
			39 00 00 00 00 00 11 BA 02 B5 02 EC 03 13 03 4A 03 78 03 EB 03 F9 03 FA
			39 01 00 00 00 00 05 BB 03 FC 03 FD
		];
		qcom,mdss-dsi-blf-10-command = [
			39 00 00 00 00 00 06 F0 55 AA 52 08 02
			39 00 00 00 00 00 02 EE 03
		    39 01 00 00 00 00 11 B0 01 2F 01 31 01 39 01 3F 01 46 01 53 01 60 01 78
			39 00 00 00 00 00 11 B1 01 8D 01 B2 01 D2 02 07 02 36 02 38 02 6A 02 A1
			39 00 00 00 00 00 11 B2 02 C7 02 FB 03 21 03 50 03 69 03 9F 03 BA 03 F0
			39 01 00 00 00 00 05 B3 03 FC 03 FD
			39 00 00 00 00 00 11 B4 01 34 01 38 01 3F 01 46 01 4C 01 59 01 65 01 7A
			39 00 00 00 00 00 11 B5 01 8E 01 B3 01 D2 02 07 02 38 02 39 02 68 02 A3
			39 01 00 00 00 00 11 B6 02 CA 03 00 03 25 03 59 03 79 03 A9 03 C1 03 F6
			39 00 00 00 00 00 05 B7 03 FE 03 FE
			39 00 00 00 00 00 11 B8 01 35 01 38 01 3F 01 46 01 4C 01 58 01 65 01 7A
			39 01 00 00 00 00 11 B9 01 8E 01 B3 01 D2 02 07 02 36 02 38 02 68 02 A2
			39 00 00 00 00 00 11 BA 02 CA 03 03 03 2B 03 71 03 EA 03 F1 03 F5 03 F9
			39 01 00 00 00 00 05 BB 03 FA 03 FC
		];
		qcom,mdss-dsi-blf-30-command = [
			39 00 00 00 00 00 06 F0 55 AA 52 08 02
			39 00 00 00 00 00 02 EE 03
		    39 01 00 00 00 00 11 B0 01 96 01 9A 01 9C 01 A0 01 A3 01 AC 01 B5 01 C3
			39 00 00 00 00 00 11 B1 01 CF 01 E8 02 00 02 28 02 53 02 55 02 7F 02 B7
			39 00 00 00 00 00 11 B2 02 DA 03 0D 03 30 03 53 03 80 03 AE 03 C5 03 F0
			39 01 00 00 00 00 05 B3 03 FC 03 FD
			39 00 00 00 00 00 11 B4 01 A8 01 A9 01 AD 01 B1 01 B5 01 BB 01 C2 01 CE
			39 00 00 00 00 00 11 B5 01 DA 01 F1 02 06 02 2F 02 56 02 57 02 82 02 BA
			39 01 00 00 00 00 11 B6 02 E2 03 17 03 3B 03 66 03 8E 03 B7 03 CB 03 F6
			39 00 00 00 00 00 05 B7 03 FE 03 FE
			39 00 00 00 00 00 11 B8 01 C0 01 C3 01 C5 01 C8 01 CB 01 D0 01 D6 01 E1
			39 01 00 00 00 00 11 B9 01 EC 02 00 02 14 02 39 02 5F 02 60 02 8A 02 C4
			39 00 00 00 00 00 11 BA 02 EB 03 26 03 57 03 EA 03 EF 03 F4 03 F7 03 F9
			39 01 00 00 00 00 05 BB 03 FA 03 FC
		];
		qcom,mdss-dsi-blf-50-command = [
			39 00 00 00 00 00 06 F0 55 AA 52 08 02
			39 00 00 00 00 00 02 EE 03
		    39 01 00 00 00 00 11 B0 01 EB 01 ED 01 F0 01 F3 01 F5 01 F6 01 F9 02 02
			39 00 00 00 00 00 11 B1 02 0A 02 1D 02 2F 02 4F 02 74 02 75 02 9B 02 D2
			39 00 00 00 00 00 11 B2 02 F8 03 27 03 47 03 4E 03 7D 03 AC 03 C3 03 F0
			39 01 00 00 00 00 05 B3 03 FC 03 FD
			39 00 00 00 00 00 11 B4 01 F2 01 F3 01 F5 01 F7 01 F9 01 FE 02 03 02 0B
			39 00 00 00 00 00 11 B5 02 14 02 24 02 34 02 54 02 75 02 76 02 9F 02 D6
			39 01 00 00 00 00 11 B6 02 FB 03 30 03 55 03 59 03 85 03 B1 03 C7 03 F6
			39 00 00 00 00 00 05 B7 03 FE 03 FE
			39 00 00 00 00 00 11 B8 02 0A 02 0B 02 0D 02 0F 02 11 02 15 02 19 02 20
			39 01 00 00 00 00 11 B9 02 28 02 36 02 45 02 63 02 83 02 84 02 AC 02 E5
			39 00 00 00 00 00 11 BA 03 0D 03 50 03 C5 03 FA 03 FB 03 FC 03 FC 03 FD
			39 01 00 00 00 00 05 BB 03 FE 03 FE
		];
		qcom,mdss-dsi-blf-75-command = [
			39 00 00 00 00 00 06 F0 55 AA 52 08 02
			39 00 00 00 00 00 02 EE 03
		    39 01 00 00 00 00 11 B0 02 53 02 54 02 55 02 56 02 57 02 5A 02 5B 02 5F
			39 00 00 00 00 00 11 B1 02 65 02 70 02 7A 02 90 02 AE 02 AF 02 D1 02 FD
			39 00 00 00 00 00 11 B2 03 1C 03 40 03 47 03 87 03 A7 03 C7 03 D7 03 EB
			39 01 00 00 00 00 05 B3 03 F9 03 FE
			39 00 00 00 00 00 11 B4 02 59 02 5A 02 5B 02 5C 02 5D 02 5F 02 62 02 67
			39 00 00 00 00 00 11 B5 02 6B 02 75 02 7F 02 97 02 B2 02 B3 02 D6 03 05
			39 01 00 00 00 00 11 B6 03 24 03 4C 03 55 03 90 03 AD 03 CA 03 D9 03 EB
			39 00 00 00 00 00 05 B7 03 FA 03 FC
			39 00 00 00 00 00 11 B8 02 69 02 6A 02 6B 02 6C 02 6D 02 6F 02 71 02 76
			39 01 00 00 00 00 11 B9 02 7A 02 84 02 8E 02 A6 02 C2 02 C3 02 E7 03 1A
			39 00 00 00 00 00 11 BA 03 42 03 94 03 E1 03 EB 03 F0 03 F5 03 F7 03 FE
			39 01 00 00 00 00 05 BB 03 FE 03 FE
		];
		qcom,mdss-dsi-on-command-state = "dsi_lp_mode";
		qcom,mdss-dsi-off-command-state = "dsi_hs_mode";
		qcom,mdss-dsi-ce-on-command-state = "dsi_hs_mode";
		qcom,mdss-dsi-ce-off-command-state = "dsi_hs_mode";
		qcom,mdss-dsi-ct-normal-command-state = "dsi_hs_mode";
		qcom,mdss-dsi-ct-warm-command-state = "dsi_hs_mode";
		qcom,mdss-dsi-ct-cold-command-state = "dsi_hs_mode";
		qcom,mdss-dsi-blf-10-command-state = "dsi_hs_mode";
		qcom,mdss-dsi-blf-30-command-state = "dsi_hs_mode";
		qcom,mdss-dsi-blf-50-command-state = "dsi_hs_mode";
		qcom,mdss-dsi-blf-75-command-state = "dsi_hs_mode";
		qcom,mdss-dsi-h-sync-pulse = <1>;
		qcom,mdss-dsi-traffic-mode = "burst_mode";
		qcom,mdss-dsi-lane-map = "lane_map_0123";
		qcom,mdss-dsi-bllp-eof-power-mode;
		qcom,mdss-dsi-bllp-power-mode;
		qcom,mdss-dsi-lane-0-state;
		qcom,mdss-dsi-lane-1-state;
		qcom,mdss-dsi-lane-2-state;
		qcom,mdss-dsi-lane-3-state;
		qcom,mdss-dsi-panel-timings = [DB 1a 10 00 3e 42 14 1c 15 03 04 00];
		qcom,mdss-dsi-t-clk-post = <0x04>;
		qcom,mdss-dsi-t-clk-pre = <0x24>;
		qcom,mdss-dsi-bl-min-level = <1>;
		qcom,mdss-dsi-bl-max-level = <4095>;
		qcom,mdss-dsi-dma-trigger = "trigger_sw";
		qcom,mdss-dsi-mdp-trigger = "none";
		qcom,mdss-dsi-bl-pmic-control-type = "bl_ctrl_wled";
		qcom,mdss-dsi-reset-sequence = <1 2>, <0 1>, <1 25>;
		qcom,mdss-pan-physical-width-dimension = <62>;
		qcom,mdss-pan-physical-height-dimension = <110>;
		qcom,mdss-pan-physical-width-dimension-full = <6210>;
		qcom,mdss-pan-physical-height-dimension-full = <11040>;
		qcom,mdss-dsi-lp11-init;
		qcom,mdss-dsi-init-delay-us = <100>;
	};
};
