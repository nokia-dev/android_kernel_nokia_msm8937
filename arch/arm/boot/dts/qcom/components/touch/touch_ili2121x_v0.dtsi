		ili2121x@41 {
			compatible = "ilitech,ili2121x";
			reg = <0x41>;
			interrupt-parent = <&tlmm>;
			interrupts = <65 0x2008>;
			/* pins used by touchscreen */
			pinctrl-names = "pmx_ts_active",
                      "pmx_ts_suspend",
                      "pmx_ts_release";
			//pinctrl-0 = <&ts_int_active &ts_reset_active>;
			//pinctrl-1 = <&ts_int_suspend &ts_reset_suspend>;
			pinctrl-0 = <&ts_int_active>;
			pinctrl-1 = <&ts_int_suspend>;
			pinctrl-2 = <&ts_release>;
      touch,irq-gpio  = <&tlmm 65 0x2008>;
      touch,irq-flags = <0x2008>;
      //touch,reset-gpio = <&tlmm 64 0x00>;
		};
