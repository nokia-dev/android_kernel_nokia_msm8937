	novatek@62 {
		compatible = "novatek,NVT-ts";
		reg = <0x62>;
		interrupt-parent = <&tlmm>;
		interrupts = <65 0x2008>;
		vdd-supply = <&nt_tp_iovdd_vreg>;		//VDDIO
		avdd-supply = <&nt_tp_avdd_vreg>;    //VDD
		pinctrl-names = "pmx_ts_active",
						"pmx_ts_suspend",
						"pmx_ts_release";
		pinctrl-0 = <&ts_int_active &ts_reset_active>;
		pinctrl-1 = <&ts_int_suspend &ts_reset_suspend>;
		pinctrl-2 = <&ts_release>;
		novatek,reset-gpio = <&tlmm 64 0x00>;
		novatek,irq-gpio  = <&tlmm 65 0x2008>;
	};