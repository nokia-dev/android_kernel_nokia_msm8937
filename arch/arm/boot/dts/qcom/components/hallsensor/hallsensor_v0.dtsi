hallsensor {
        compatible = "fih,hallsensor";
        interrupt-parent = <&tlmm>;
        interrupts = <50 0x3>;
        hallsensor,irq-gpio  = <&tlmm 50 0x00>;
        vdd-supply = <&pm8937_l6>;
        hall-open,linux,code = <0x2f0>;
        hall-close,linux,code = <0x2f1>;
};

