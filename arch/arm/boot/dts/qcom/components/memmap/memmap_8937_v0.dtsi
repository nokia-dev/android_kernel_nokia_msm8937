/*
  FIH memory hole setting
*/

/* ref: msm8937.dtsi */

/ {
	reserved-memory {
		fih_mem: fih_region@0 {
			compatible = "removed-dma-pool";
			no-map;
			reg = <0 0xC3200000 0 0x00900000>;
		};
	};
};

/**************************************************************
 * START       | SIZE        | TARGET
 * -------------------------------------------------------- 0MB
 * 0xC320_0000 | 0x0020_0000 | modem rf_nv (2MB)
 * 0xC340_0000 | 0x0020_0000 | modem cust_nv (2MB)
 * 0xC360_0000 | 0x0020_0000 | modem default_nv (2MB)
 * 0xC380_0000 | 0x0010_0000 | modem log (1MB)
  * -------------------------------------------------------- 7MB
 * 0xC390_0000 | 0x0004_0000 | last_alog_main (256KB)
 * 0xC394_0000 | 0x0004_0000 | last_alog_events (256KB)
 * 0xC398_0000 | 0x0004_0000 | last_alog_radio (256KB)
 * 0xC39C_0000 | 0x0004_0000 | last_alog_system (256KB)
 * 0xC3A0_0000 | 0x0004_0000 | last_kmsg (256KB)
 * 0xC3A4_0000 | 0x0002_0000 | last_blog (128KB)
 * 0xC3A6_0000 | 0x0002_0000 | blog (128KB)
 * -------------------------------------------------------- 8.5MB
 * 0xC3A8_0000 | 0x0000_0040 | hwid:hwcfg (64B)
 * 0xC3A8_0040 | 0x0000_0040 | secboot:devinfo (64B)
 * 0xC3A8_0080 | 0x0000_0100 | secboot:unlock (256B)
 * 0xC3A8_0180 | 0x0000_0080 | sutinfo (128B)
 * 0xC3A8_0200 | 0x0000_0010 | no use (16B)
 * 0xC3A8_0210 | 0x0000_0010 | bset (16B)
 * 0xC3A8_0220 | 0x0000_0010 | bat-id adc (16B)
 * 0xC3A8_0230 | 0x0000_0010 | no use (16B)
 * 0xC3A8_0240 | 0x0000_0020 | apr (32B)
 * 0xC3A8_0260 | 0x0000_0180 | no use (384B)
 * 0xC3A8_03E0 | 0x0000_0020 | mem (32B)
 * 0xC3A8_0400 | 0x0000_0C00 | no use (3KB)
 * 0xC3A8_1000 | 0x0000_1000 | e2p (4KB)
 * 0xC3A8_2000 | 0x0000_1000 | cda (4KB)
 * 0xC3A8_3000 | 0x0000_1000 | note (4KB)
 * 0xC3A8_4000 | 0x0000_1000 | hwcfg (4KB)
 * 0xC3A8_5000 | 0x0000_1000 | fac (4KB)
 * 0xC3A8_6000 | 0x0000_2000 | no use 5 (8KB)
 * 0xC3A8_8000 | 0x0004_0000 | fver (256KB)
 * 0xC3AC_8000 | 0x0000_4000 | sensordata (16KB)
 * 0xC3AC_C000 | 0x0000_4000 | lcmdata (16KB)
 * 0xC3AD_0000 | 0x0003_0000 | no use 6 (208KB)
 * -------------------------------------------------------- 9MB
 * 0xC3B0_0000 | 0x0090_0000 | HLOS (9MB)
 */