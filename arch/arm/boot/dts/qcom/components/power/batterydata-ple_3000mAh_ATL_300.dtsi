/* Copyright (c) 2014-2015, The Linux Foundation. All rights reserved.
 *
 * This program is free software; you can redistribute it and/or modify
 * it under the terms of the GNU General Public License version 2 and
 * only version 2 as published by the Free Software Foundation.
 *
 * This program is distributed in the hope that it will be useful,
 * but WITHOUT ANY WARRANTY; without even the implied warranty of
 * MERCHANTABILITY or FITNESS FOR A PARTICULAR PURPOSE.  See the
 * GNU General Public License for more details.
 */

qcom,fih-ple-4v4-3000mah-300k {
	qcom,nom-batt-capacity-mah = <3000>;
	qcom,max-voltage-uv = <4400000>;
	qcom,v-cutoff-uv = <3300000>;
	qcom,chg-term-ua = <100000>;
	qcom,batt-id-kohm = <300>;
	qcom,battery-type = "SCUD_ATL";
	qcom,cool-bat-decidegc = <150>;
	qcom,battery-beta = <3435>;
	qcom,chg-rslow-comp-c1 = <2585818>;
	qcom,chg-rslow-comp-c2 = <2678528>;
	qcom,chg-rs-to-rslow = <823170>;
	qcom,chg-rslow-comp-thr = <0x99>;
	qcom,checksum = <0x146B>;
	qcom,gui-version = "PMI8950GUI - 2.0.0.16";

	qcom,fastchg-current-ma = <2000>;
	qcom,fastchg-current-comp = <1200>;
	
	qcom,high-float-voltage-comp = <16>; /* need change to 16 if float-voltage change to 4.4 */
	qcom,low-float-voltage-comp = <6>; /* 4.3 */
	qcom,high-fastchg-current-comp = <1200>;
	qcom,low-fastchg-current-comp = <700>;
		
	qcom,fg-cc-cv-threshold-mv = <4390>;
	qcom,thermal-coefficients = [C5 86 BE 50 D1 37];
	qcom,fg-profile-data = [
		 E0 83 CC 7C 
		 0A 81 10 77 
		 65 83 AD 74 
		 A4 89 A8 94 
		 27 82 B4 99 
		 86 BC D8 C8 
		 56 11 F3 83 
		 26 7D 3F 81 
		 5D 77 59 83 
		 EF 5A A0 81 
		 F8 8D 3F 82 
		 1A 9A 81 BD 
		 BE CA 55 0E 
		 31 0C 49 5A 
		 14 70 B2 FD 
		 BB 3F 15 3C 
		 5F 30 00 00 
		 66 45 6E 32 
		 8D 36 00 00 
		 00 00 00 00 
		 00 00 00 00 
		 DA 6A D5 69 
		 B0 69 B1 80 
		 63 6E 04 60 
		 BC 63 57 7B 
		 41 6D BE 59 
		 54 9E BD C3 
		 08 45 60 05 
		 5D A0 71 0C 
		 28 00 FF 36 
		 F0 11 30 03 
		 00 00 00 0C 
	];
};
