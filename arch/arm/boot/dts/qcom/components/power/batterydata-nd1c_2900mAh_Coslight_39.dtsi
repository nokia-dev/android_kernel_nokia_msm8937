/* Copyright (c) 2014-2015, The Linux Foundation. All rights reserved.
 *
 * This program is free software; you can redistribute it and/or modify
 * it under the terms of the GNU General Public License version 2 and
 * only version 2 as published by the Free Software Foundation.
 *
 * This program is distributed in the hope that it will be useful,
 * but WITHOUT ANY WARRANTY; without even the implied warranty of
 * MERCHANTABILITY or FITNESS FOR A PARTICULAR PURPOSE.  See the
 * GNU General Public License for more details.
 */

qcom,fih-nd1-4v4-2900mah-39k {
	qcom,nom-batt-capacity-mah = <2900>;
	qcom,max-voltage-uv = <4400000>;
	qcom,v-cutoff-uv = <3400000>;
	qcom,chg-term-ua = <100000>;
	qcom,batt-id-kohm = <39>;
	qcom,battery-type = "MSM8937_ND1_Coslight_39k_battery";
	qcom,cool-bat-decidegc = <150>;
	qcom,battery-beta = <3380>;
	qcom,chg-rslow-comp-c1 = <3064189>;
	qcom,chg-rslow-comp-c2 = <4718819>;
	qcom,chg-rs-to-rslow = <706209>;
	qcom,chg-rslow-comp-thr = <0xAC>;
	qcom,checksum = <0x987E>;
	qcom,gui-version = "PMI8950GUI - 2.0.0.16";

	qcom,fastchg-current-ma = <2000>;
	qcom,fastchg-current-comp = <1200>; // high temp
	
	qcom,high-float-voltage-comp = <16>; /* need change to 16 if float-voltage change to 4.4 */
	qcom,low-float-voltage-comp = <0>; /* 4.4 */
	qcom,high-fastchg-current-comp = <1200>;
	qcom,low-fastchg-current-comp = <700>;
	
	qcom,fg-cc-cv-threshold-mv = <4380>;
	qcom,thermal-coefficients = [C5 86 BE 50 D1 37];
	qcom,fg-profile-data = [
		 DC 83 82 7C 
		 A8 80 04 76 
		 59 83 7C 66 
		 BF 83 CD 8E 
		 33 82 F9 98 
		 15 B7 C0 C2 
		 52 16 D8 83 
		 CC 77 0A 80 
		 98 74 5A 83 
		 95 41 D8 83 
		 5D 94 62 82 
		 82 98 C4 B6 
		 D6 C2 4C 13 
		 C5 0B 80 5A 
		 14 70 7D FE 
		 43 3F 74 3C 
		 DE 33 00 00 
		 53 46 30 39 
		 3E 25 00 00 
		 00 00 00 00 
		 00 00 00 00 
		 17 6A BE 69 
		 26 68 8B 81 
		 3D 6E DD 60 
		 D0 61 0F 80 
		 AD 6D FD 60 
		 6A 66 FB A8 
		 18 18 61 D9 
		 5E A0 71 0C 
		 28 00 FF 36 
		 F0 11 30 03 
		 00 00 00 0C 
	];
};