/*
  Defined External LDO via fixed regulator driver control

*/

	nt_tp_avdd_vreg: regulator_tp_avdd {
		status = "okay";
		compatible = "regulator-fixed";
		regulator-name = "nt_tp_avdd_vreg";
    regulator-min-microvolt = <2800000>;
    regulator-max-microvolt = <2800000>;
		startup-delay-us = <100>;
		enable-active-high;
		gpio = <&tlmm 47 0>;
	};

	nt_tp_iovdd_vreg: regulator_tp_iovdd {
		status = "okay";
		compatible = "regulator-fixed";
		regulator-name = "nt_tp_iovdd_vreg";
    regulator-min-microvolt = <1800000>;
    regulator-max-microvolt = <1800000>;
		startup-delay-us = <100>;
		enable-active-high;
		gpio = <&tlmm 46 0>;
	};
