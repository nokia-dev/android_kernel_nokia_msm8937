/*
 * Copyright (c) 2015, The Linux Foundation. All rights reserved.
 *
 * This program is free software; you can redistribute it and/or modify
 * it under the terms of the GNU General Public License version 2 and
 * only version 2 as published by the Free Software Foundation.
 *
 * This program is distributed in the hope that it will be useful,
 * but WITHOUT ANY WARRANTY; without even the implied warranty of
 * MERCHANTABILITY or FITNESS FOR A PARTICULAR PURPOSE.  See the
 * GNU General Public License for more details.
 */

&int_codec {
	status = "okay";
	qcom,model = "msm8952-snd-card-nd1";
	qcom,msm-hs-micbias-type = "external";
	qcom,msm-mbhc-hphl-swh = <1>;
	qcom,msm-mbhc-gnd-swh = <1>;
	/delete-property/ qcom,msm-ear-switch-en;
	/delete-property/ qcom,msm-ear-switch-in;
	qcom,cdc-us-euro-gpios = <&tlmm 63 0>;

	qcom,audio-routing =
	"RX_BIAS", "MCLK",
	"SPK_RX_BIAS", "MCLK",
	"INT_LDO_H", "MCLK",
	"MIC BIAS External", "Handset Mic",
	"MIC BIAS External2", "Headset Mic",
	"MIC BIAS External", "Secondary Mic",
	"AMIC1", "MIC BIAS External",
	"AMIC2", "MIC BIAS External2",
	"AMIC3", "MIC BIAS External";
	qcom,msm-ext-pa = "quaternary";
	fih,ext-spk-amp-support;

	qcom,msm-gpios =
		"pri_i2s",
		"us_eu_gpio",
		"quat_i2s";
	qcom,pinctrl-names =
		"all_off",
		"pri_i2s_act",
		"us_eu_gpio_act",
		"pri_i2s_us_eu_gpio_act",
		"quat_act",
		"quat_pri_i2s_act",
		"quat_us_eu_gpio_act",
		"quat_us_eu_gpio_pri_i2s_act";
	pinctrl-names =
		"all_off",
		"pri_i2s_act",
		"us_eu_gpio_act",
		"pri_i2s_us_eu_gpio_act",
		"quat_act",
		"quat_pri_i2s_act",
		"quat_us_eu_gpio_act",
		"quat_us_eu_gpio_pri_i2s_act";

	pinctrl-0 = <&cdc_pdm_lines_sus
			&cdc_pdm_lines_2_sus &cross_conn_det_sus
			&sec_tlmm_lines_sus>;
	pinctrl-1 = <&cdc_pdm_lines_act
			&cdc_pdm_lines_2_act &cross_conn_det_sus
			&sec_tlmm_lines_sus>;
	pinctrl-2 = <&cdc_pdm_lines_sus
			&cdc_pdm_lines_2_sus &cross_conn_det_act
			&sec_tlmm_lines_sus>;
	pinctrl-3 = <&cdc_pdm_lines_act
			&cdc_pdm_lines_2_act &cross_conn_det_act
			&sec_tlmm_lines_sus>;
	pinctrl-4 = <&cdc_pdm_lines_sus
			&cdc_pdm_lines_2_sus &cross_conn_det_sus
			&sec_tlmm_lines_act>;
	pinctrl-5 = <&cdc_pdm_lines_act
			&cdc_pdm_lines_2_act &cross_conn_det_sus
			&sec_tlmm_lines_act>;
	pinctrl-6 = <&cdc_pdm_lines_sus
			&cdc_pdm_lines_2_sus &cross_conn_det_act
			&sec_tlmm_lines_act>;
	pinctrl-7 = <&cdc_pdm_lines_act
			&cdc_pdm_lines_2_act &cross_conn_det_act
			&sec_tlmm_lines_act>;
};

&soc {
	fih_info_management {
		acdbdir="ND1";
	};
};
