/*
 * Copyright (c) 2016, The Linux Foundation. All rights reserved.
 *
 * This program is free software; you can redistribute it and/or modify
 * it under the terms of the GNU General Public License version 2 and
 * only version 2 as published by the Free Software Foundation.
 *
 * This program is distributed in the hope that it will be useful,
 * but WITHOUT ANY WARRANTY; without even the implied warranty of
 * MERCHANTABILITY or FITNESS FOR A PARTICULAR PURPOSE.  See the
 * GNU General Public License for more details.
 */

/dts-v1/;

#include "msm8940.dtsi"
#include "msm8940-pmi8950-fih-D1-EVT.dtsi"

/ {
	model = "Qualcomm Technologies, Inc. MSM8940-PMI8950 - FIH D1 EVT";
	compatible = "qcom,msm8940-mtp", "qcom,msm8940", "qcom,mtp";
	qcom,msm-id = <313 0x1000>;
	qcom,board-id= <0x90 0>, <0x94 0>;
	qcom,pmic-id = <0x10019 0x020011 0x0 0x0>;
};
